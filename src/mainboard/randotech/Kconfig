## src/mainboard/randotech/Kconfig
```kconfig
## SPDX-License-Identifier: GPL-2.0-only

if VENDOR_RANDOTECH

choice
	prompt "Mainboard model"

source "src/mainboard/randotech/*/Kconfig.name"

endchoice

source "src/mainboard/randotech/*/Kconfig"

config MAINBOARD_VENDOR
	string
	default "R&OTECH"

endif # VENDOR_RANDOTECH
```

## src/mainboard/randotech/Kconfig.name
```kconfig
## SPDX-License-Identifier: GPL-2.0-only

config VENDOR_RANDOTECH
	bool "R&O Industrial Technology Co., Limited"
```

## src/mainboard/randotech/k9ethv10/Kconfig
```kconfig
## SPDX-License-Identifier: GPL-2.0-only

if BOARD_RANDOTECH_K9ETHV10

config BOARD_SPECIFIC_OPTIONS
	def_bool y
	select NORTHBRIDGE_INTEL_SANDYBRIDGE
	select SOUTHBRIDGE_INTEL_BD82X6X
	select SUPERIO_NUVOTON_NCT5532D
	select BOARD_ROMSIZE_KB_4096
	select HAVE_ACPI_RESUME
	select HAVE_ACPI_TABLES
	select INTEL_INT15
	select SERIRQ_CONTINUOUS_MODE
	select INTEL_GMA_HAVE_VBT
	select USE_NATIVE_RAMINIT
	select MAINBOARD_HAS_LIBGFXINIT
	select AZALIA_USE_LEGACY_VERB_TABLE

config MAINBOARD_DIR
	string
	default "randotech/k9ethv10"

config MAINBOARD_PART_NUMBER
	string
	default "K9-ETH V1.0"

config VGA_BIOS_ID
	string
	default "8086,016a"

config DRAM_RESET_GATE_GPIO
	int
	default 60

config USBDEBUG_HCD_INDEX
	int
	default 1
endif
```

## src/mainboard/randotech/k9ethv10/Kconfig.name
```kconfig
## SPDX-License-Identifier: GPL-2.0-only

config BOARD_RANDOTECH_K9ETHV10
	bool "K9-ETH V1.0"
```
